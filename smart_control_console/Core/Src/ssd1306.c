#include "ssd1306.h"
#include <string.h>

extern I2C_HandleTypeDef hi2c1;

#define SSD1306_ADDR 0x78
#define SSD1306_WIDTH 128
#define SSD1306_HEIGHT 64

static uint8_t buffer[SSD1306_WIDTH * SSD1306_HEIGHT / 8];

static void SSD1306_WriteCommand(uint8_t cmd)
{
    uint8_t data[2] = {0x00, cmd};
    HAL_I2C_Master_Transmit(&hi2c1, SSD1306_ADDR, data, 2, 100);
}

static void SSD1306_WriteData(uint8_t *data, uint16_t size)
{
    uint8_t temp[129];
    temp[0] = 0x40;

    while (size)
    {
        uint16_t chunk = size > 128 ? 128 : size;
        memcpy(&temp[1], data, chunk);
        HAL_I2C_Master_Transmit(&hi2c1, SSD1306_ADDR, temp, chunk + 1, 100);
        data += chunk;
        size -= chunk;
    }
}

void SSD1306_Init(void)
{
    HAL_Delay(100);

    SSD1306_WriteCommand(0xAE);
    SSD1306_WriteCommand(0x20);
    SSD1306_WriteCommand(0x00);
    SSD1306_WriteCommand(0xB0);
    SSD1306_WriteCommand(0xC8);
    SSD1306_WriteCommand(0x00);
    SSD1306_WriteCommand(0x10);
    SSD1306_WriteCommand(0x40);
    SSD1306_WriteCommand(0x81);
    SSD1306_WriteCommand(0x7F);
    SSD1306_WriteCommand(0xA1);
    SSD1306_WriteCommand(0xA6);
    SSD1306_WriteCommand(0xA8);
    SSD1306_WriteCommand(0x3F);
    SSD1306_WriteCommand(0xA4);
    SSD1306_WriteCommand(0xD3);
    SSD1306_WriteCommand(0x00);
    SSD1306_WriteCommand(0xD5);
    SSD1306_WriteCommand(0x80);
    SSD1306_WriteCommand(0xD9);
    SSD1306_WriteCommand(0xF1);
    SSD1306_WriteCommand(0xDA);
    SSD1306_WriteCommand(0x12);
    SSD1306_WriteCommand(0xDB);
    SSD1306_WriteCommand(0x40);
    SSD1306_WriteCommand(0x8D);
    SSD1306_WriteCommand(0x14);
    SSD1306_WriteCommand(0xAF);
}

void SSD1306_Clear(void)
{
    memset(buffer, 0x00, sizeof(buffer));
}

void SSD1306_Fill(void)
{
    memset(buffer, 0xFF, sizeof(buffer));
}

void SSD1306_UpdateScreen(void)
{
    for (uint8_t page = 0; page < 8; page++)
    {
        SSD1306_WriteCommand(0xB0 + page);
        SSD1306_WriteCommand(0x00);
        SSD1306_WriteCommand(0x10);
        SSD1306_WriteData(&buffer[SSD1306_WIDTH * page], SSD1306_WIDTH);
    }
}

static uint8_t cursor_x = 0;
static uint8_t cursor_y = 0;

void SSD1306_DrawPixel(uint8_t x, uint8_t y, uint8_t color)
{
    if (x >= 128 || y >= 64) return;

    if (color)
        buffer[x + (y / 8) * 128] |= (1 << (y % 8));
    else
        buffer[x + (y / 8) * 128] &= ~(1 << (y % 8));
}

void SSD1306_SetCursor(uint8_t x, uint8_t y)
{
    cursor_x = x;
    cursor_y = y;
}

// 5x7 ASCII Font (32-126)
static const uint8_t font5x7[][5] = {
    {0x00, 0x00, 0x00, 0x00, 0x00}, // 32  (space)
    {0x00, 0x00, 0x5F, 0x00, 0x00}, // 33 !
    {0x00, 0x07, 0x00, 0x07, 0x00}, // 34 "
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    {0x10, 0x08, 0x08, 0x10, 0x08}, // 126 ~
};

static void SSD1306_WriteChar(char c)
{
    // Convert to font array index (ASCII 32-126)
    if (c < 32 || c > 126)
    {
        c = 32; // Default to space for unsupported characters
    }
    
    const uint8_t *bitmap = font5x7[c - 32];

    for (uint8_t col = 0; col < 5; col++)
    {
        for (uint8_t row = 0; row < 8; row++)
        {
            if (bitmap[col] & (1 << row))
                SSD1306_DrawPixel(cursor_x + col, cursor_y + row, 1);
        }
    }

    cursor_x += 6; // 5 pixels + 1 pixel spacing
}

void SSD1306_WriteString(char *str)
{
    while (*str)
    {
        SSD1306_WriteChar(*str++);
    }
}
